## main/Kconfig.projbuild
```kconfig
menu "Thermo Sensor"

    choice SENSOR_TYPE
        prompt "Sensortyp (LP-Core)"
        default SENSOR_BME280
        help
            Waehlt den Sensor-Adapter, der in den LP-Core gebaut wird.

        config SENSOR_BME280
            bool "Bosch BME280 / BMP280 (z. B. GY-BME280)"

        config SENSOR_SHT4X
            bool "Sensirion SHT4x (SHT40 / SHT41 / SHT45)"
    endchoice

    config SENSOR_I2C_ADDR
        hex "I2C-Adresse (7 Bit)"
        default 0x76 if SENSOR_BME280
        default 0x44 if SENSOR_SHT4X
        help
            BME280: 0x76 (SDO an GND) oder 0x77 (SDO an VCC).
            SHT4x:  0x44 (AD1B), 0x45 (BD1B), 0x46 (CD1B).

    config THERMO_TEMP_OFFSET_C100
        int "Temperature-Offset (0,01 Grad C)"
        range -1000 1000
        default 0
        help
            Wird zur gemessenen Temperatur addiert. Beispiel: Anzeige 27,50,
            Referenz 26,30 -> Offset -120. Laufzeit-Aenderung per NVS, siehe README.

    config THERMO_RH_OFFSET_C100
        int "Feuchte-Offset (0,01 %RH)"
        range -2000 2000
        default 0

    config THERMO_OFFSET_FROM_KCONFIG
        bool "Offsets aus Kconfig beim ersten Boot in NVS uebernehmen"
        default n
        help
            Aus: Ein im NVS gespeicherter Offset hat Vorrang vor diesen Werten.
            An: Die Kconfig-Werte ueberschreiben den NVS-Wert beim ersten Boot.

endmenu
```
